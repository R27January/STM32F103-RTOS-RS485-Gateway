#include "oled_font.h"

static const uint8_t font_space[5] = {0x00,0x00,0x00,0x00,0x00};
static const uint8_t font_unknown[5] = {0x02,0x01,0x51,0x09,0x06};

static const uint8_t font_digit[10][5] =
{
    {0x3E,0x51,0x49,0x45,0x3E}, /* 0 */
    {0x00,0x42,0x7F,0x40,0x00}, /* 1 */
    {0x42,0x61,0x51,0x49,0x46}, /* 2 */
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    {0x06,0x49,0x49,0x29,0x1E}, /* 9 */
};

static const uint8_t font_upper[26][5] =
{
    {0x7E,0x11,0x11,0x11,0x7E}, /* A */
    {0x7F,0x49,0x49,0x49,0x36}, /* B */
    {0x3E,0x41,0x41,0x41,0x22}, /* C */
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    {0x61,0x51,0x49,0x45,0x43}, /* Z */
};

static const uint8_t font_colon[5] = {0x00,0x36,0x36,0x00,0x00};
static const uint8_t font_minus[5] = {0x08,0x08,0x08,0x08,0x08};
static const uint8_t font_underscore[5] = {0x40,0x40,0x40,0x40,0x40};
static const uint8_t font_dot[5] = {0x00,0x60,0x60,0x00,0x00};
static const uint8_t font_slash[5] = {0x20,0x10,0x08,0x04,0x02};

const uint8_t *OLED_Font_Get5x7(char ch)
{
    if (ch == ' ') return font_space;
    if (ch >= '0' && ch <= '9') return font_digit[ch - '0'];
    if (ch >= 'A' && ch <= 'Z') return font_upper[ch - 'A'];
    if (ch >= 'a' && ch <= 'z') return font_upper[ch - 'a'];

    switch (ch)
    {
        case ':': return font_colon;
        case '-': return font_minus;
        case '_': return font_underscore;
        case '.': return font_dot;
        case '/': return font_slash;
        default:  return font_unknown;
    }
}
